//Accelerometer
#include <MPU6050.h>
#include<Wire.h>
//OLED screen
#include "SoftwareSerial.h"
#include <time.h>
#include <U8glib.h>
SoftwareSerial mySerial(10, 11);
U8GLIB_SSD1306_128X64 oled(U8G_I2C_OPT_NONE);

static unsigned char u8g_logo_bits[] = {
   0xff, 0xff, 0xff, 0xff, 0x3f, 0xff, 0xff, 0xff, 0xff, 0x3f, 0xe0, 0xe0,
   0xff, 0x3f, 0xff, 0xff, 0xff, 0xff, 0x3f, 0xff, 0xff, 0xff, 0xff, 0x3f };
static unsigned char circle[] = {
  0xff, 0xff, 0xff, 0xff, 0xff, 0xff, 0xff, 0xff, 0xff, 0xff, 0xff, 0xff,
  0x00, 0x00, 0xff, 0xff, 0xff, 0xff, 0xff, 0xff, 0xff, 0xff, 0xff, 0xff,
  0xff, 0xff, 0xff, 0xff, 0xff, 0xff, 0xff, 0xff, 0xff, 0xff, 0xff, 0xff,
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  0x00, 0x00, 0xff, 0xff, 0xff, 0xff, 0xff, 0xff, 0xff, 0xff, 0xff, 0xff
  };

#define UPDATEX (x + (AcX-OriginX)/500)
#define UPDATEY (y + (AcY-OriginY)/500)

const int MPU=0x68; 
int16_t AcX,AcY,AcZ,GyX,GyY,GyZ,OriginX,OriginY;
int8_t SizeZ = 10;
int8_t x = 64; 
int8_t y = 32;
int8_t updates = 100;

void setup() {
  Wire.begin();
  Wire.beginTransmission(MPU);
  Wire.write(0x6B); 
  Wire.write(0);    
  Wire.endTransmission(true);
  Serial.begin(115200);
  oled.setFont(u8g_font_helvB10);

  //Begin accelerometer transmission
  Wire.beginTransmission(MPU);
  Wire.write(0x3B);  
  Wire.endTransmission(false);
  Wire.requestFrom(MPU,12,true);

  //Random
  srand(time(NULL));
  
  //Set initial position
  OriginX = Wire.read()<<8|Wire.read();
  OriginY = Wire.read()<<8|Wire.read();
}

void loop() {
  Wire.beginTransmission(MPU);
  Wire.write(0x3B);  
  Wire.endTransmission(false);
  Wire.requestFrom(MPU,12,true);
  
  AcX=Wire.read()<<8|Wire.read();    
  AcY=Wire.read()<<8|Wire.read();  
  AcZ=Wire.read()<<8|Wire.read();  
  GyX=Wire.read()<<8|Wire.read();  
  GyY=Wire.read()<<8|Wire.read();  
  GyZ=Wire.read()<<8|Wire.read();

  Serial.print("Accelerometer: ");
  Serial.print("X = "); Serial.print(AcX);
  Serial.print(" | Y = "); Serial.print(AcY);
  Serial.print(" | Z = "); Serial.println(AcZ); 
  
  Serial.print("Gyroscope: ");
  Serial.print("X = "); Serial.print(GyX);
  Serial.print(" | Y = "); Serial.print(GyY);
  Serial.print(" | Z = "); Serial.println(GyZ);
  Serial.println(" ");

  //Draw
  oled.firstPage();
  do {
    draw();
  } while(oled.nextPage());

  if (UPDATEX > 0 && UPDATEX < 128-6){
    x = UPDATEX;
  }
  if (UPDATEY > 0 && UPDATEY < 64-6) {
    y = UPDATEY;
  }
  
  delay(1000/updates);

}

void draw() {
  //oled.drawStr(10,10,"Hej");
  //oled.drawLine(10,10,20,20);
  oled.drawBox(x,y,SizeZ,SizeZ);
  oled.drawCircle(64,32,30);
  //oled.drawXBM(0,0,38,24,u8g_logo_bits);
  oled.drawXBM(0,0,48,32,circle);
}
